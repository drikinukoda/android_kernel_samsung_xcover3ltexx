/*
 * Copyright (C) 2014 Marvell
 * Yi Zhang <yizhang@marvell.com>
 */

/* ocv table is for RosaM battery */
/* ntc table is for NCP03XH223E05RL */

&pmic0 {
	charger {
		prechg-current = <450>;
		prechg-voltage = <3000>;
		fastchg-voltage = <4400>;
		fastchg-cur = <1500>;
		fastchg-eoc = <150>;
		fastchg-tout = <8>;
		recharge-thr = <200>;
		dcp-limit = <700>;
		status = "okay";
	};

	/* KSND Headset detection by PMIC  */
	headset {
		marvell,headset-flag = <0>;
		marvell,hook-press-th = <76>;
		marvell,vol-up-press-th = <150>;
		marvell,vol-down-press-th = <350>;
		marvell,mic-det-th = <430>;
		marvell,press-release-th = <430>;
                marvell,micbias-supply = <&ldo16>;
		marvell,micbias-voltage = <2800000>;
		marvell,gpio5v-detect-mode = <1>;
		status = "okay";
	};

	battery {
		sleep-period = <1000>;		/* second */
		low-threshold = <30>;		/* % */
		high-threshold = <50>;		/* % */
		alart-percent = <5>;		/* % */

		cc-fixup = <100>;

		power-off-th = <3350>;		/* mv */
		safe-power-off-th = <3000>;	/* mv */

		io-channels = <&gpadc 7>,  /* vbat */
			           <&gpadc 13>, /* vbat_slp */
				   <&gpadc 14>, /* gpadc0_res */
				   <&gpadc 15>, /* gpadc1_res */
				   <&gpadc 16>, /* gpadc2_res */
				   <&gpadc 17>; /* gpadc3_res */
		io-channel-names = "vbat",
				   "vbat_slp",
				   "gpadc0_res",
				   "gpadc1_res",
				   "gpadc2_res",
				   "gpadc3_res";

		bat-capacity = <4000>;	/* mAh */
		ocv-table = <
			3262 3393 3479 3542 3592 3631 3653 3663 3669 3673
			3677 3680 3685 3693 3701 3707 3712 3717 3723 3728
			3732 3736 3739 3743 3746 3750 3754 3757 3761 3764
			3767 3770 3772 3775 3777 3780 3783 3786 3789 3792
			3795 3798 3801 3805 3808 3812 3816 3820 3824 3829
			3833 3838 3843 3848 3854 3860 3867 3874 3881 3890
			3899 3908 3918 3927 3936 3945 3953 3962 3970 3979
			3987 3995 4004 4013 4022 4032 4042 4052 4062 4071
			4080 4090 4100 4111 4121 4132 4142 4153 4164 4175
			4186 4197 4209 4220 4232 4244 4256 4269 4282 4297 4314
		>;

		abs-lowest-temp = <20>;
		t1-degree = <0>;	/* -20C */
		t2-degree = <20>;	/* 0C */
		t3-degree = <50>;	/* 30C */
		t4-degree = <65>;	/* 45C */

		times-in-minus-ten = <2>;
		offset-in-minus-ten = <100>;
		times-in-zero = <1>;
		offset-in-zero = <0>;

		soc-low-th-cycle = <15>;
		soc-high-th-cycle = <85>;

		zero-degree-ohm = <59881>;

		ntc-table =
				/* -25 ~ -21 */
				<229000 25>,
				<220000 24>,
				<211629 23>,
				<192629 22>,
				<183133 21>,

				/* -20 ~ -11 */
				<174166 20>,
				<165695 19>,
				<157689 18>,
				<150121 17>,
				<142980 16>,
				<136118 15>,
				<129748 14>,
				<123714 13>,
				<118029 12>,
				<112591 11>,

				/* -10 ~ -1 */
				<107437 10>,
				<102549 9>,
				<97913 8>,
				<93514 7>,
				<89319 6>,
				<87379 5>,
				<83184 4>,
				<79204 3>,
				<75425 2>,
				<71837 1>, /* negative temperature */

				/* 0 ~ 9 */
				<70623 0>,
				<68000 1>,
				<66006 2>,
				<63806 3>,
				<60431 4>,
				<57881 5>,
				<55467 6>,
				<53173 7>,
				<50892 8>,
				<48718 9>,

				/* 10 ~ 19 */
				<41724 10>,
				<39436 11>,
				<37871 12>,
				<36376 13>,
				<34948 14>,
				<33585 15>,
				<32282 16>,
				<31037 17>,
				<29846 18>,
				<28708 19>,

				/* 20 ~ 29 */
				<27619 20>,
				<26577 21>,
				<25582 22>,
				<24628 23>,
				<23715 24>,
				<22839 25>,
				<22000 26>,
				<21195 27>,
				<20424 28>,
				<19683 29>,

				/* 30 ~ 39 */
				<18973 30>,
				<18292 31>,
				<17640 32>,
				<17014 33>,
				<16414 34>,
				<15838 35>,
				<15285 36>,
				<14755 37>,
				<14245 38>,
				<13756 39>,

				/* 40 ~ 49 */
				<13286 40>,
				<12843 41>,
				<12400 42>,
				<11980 43>,
				<11577 44>,
				<11190 45>,
				<10817 46>,
				<10459 47>,
				<10114 48>,
				<9782 49>,

				/* 50 ~ 59 */
				<9462 50>,
				<9154 51>,
				<8858 52>,
				<8572 53>,
				<8297 54>,
				<8032 55>,
				<7777 56>,
				<7531 57>,
				<7294 58>,
				<7065 59>,

				/* 60 ~ 65 */
				<6844 60>,
				<6844 61>,
				<6631 62>,
				<6429 63>,
				<6046 64>,
				<5865 65>;
		};
};
