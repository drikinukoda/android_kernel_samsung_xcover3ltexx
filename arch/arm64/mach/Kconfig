## arch/arm64/mach/Kconfig
```kconfig
if ARCH_MMP

menu "Marvell PXA19x8 Implementations"

config MACH_PXA1908DKB
	bool "Marvell's PXA1908 DKB"
	help
	  Say 'Y' here if you want to support the Marvell PXA1908-based
	  DKB Board.

config MACH_J1LTE
	bool "Samsung's PXA1908 J1 LTE Development Board"
	help
	  Say 'Y' here if you want to support the Samsung PXA1908-based
	  J1 LTE Development Board.

config MACH_J1LTE_CHN_CMCC
	bool "Samsung's PXA1908 J1 LTE CHN CMCC Development Board"
	help
	  Say 'Y' here if you want to support the Samsung PXA1908-based
	  J1 LTE CHN CMCC Development Board.

config MACH_XCOVER3LTE
	bool "Samsung's PXA1908 XCOVER3LTE Development Board"
	help
	  Say 'Y' here if you want to support the Samsung PXA1908-based
	  XCOVER3LTE Development Board.
config MACH_J1NLTE
    bool "Samsung's PXA1908 J1NLTE Development Board"
     help
       Say 'Y' here if you want to support the Samsung PXA1908-based
       J1NLTE Development Board.

config MACH_J1NLTE_SEA_OPEN
    bool "Samsung's PXA1908 J1NLTE Development Board"
     help
       Say 'Y' here if you want to support the Samsung PXA1908-based
       J1NLTE SEA OPEN Development Board.
       
config MACH_DEGASVELTE
	bool "Samsung's PXA1908 DEGASVELTE Development Board"
	help
	  Say 'Y' here if you want to support the Samsung PXA1908-based
	  DEGASVELTE Development Board.

config SAMSUNG_PRODUCT_SHIP
    bool "set up for product shipping"
    default n

menuconfig SEC_TIMA
	bool "Samsung TIMA Feature"
	default n
	help
	  Samsung TIMA Feature.

if SEC_TIMA
config TIMA_LKMAUTH
    bool "Enable LKM authentication TIMA feature"
    default n
    help
      TIMA authenticates loaded kernel modules. Disable it if you don't
      want TIMA enabled.

config TIMA_PKM
    bool "Enable PKM virtual address store TIMA feature"
    default n
    help
      secure world cannot read physical address so storing virtual address

config TIMA_LKMAUTH_CODE_PROT
    bool
    depends on TIMA_LKMAUTH
    default y
    help
      When enabled, this feature will mark all Executable sections in an
      LKM as RO

config TIMA_UEVENT
    bool "Uevent message propagation for TIMA"
    default n
    help
      Uevent messages for TIMA PKM/LKM

config TIMA_LOG
    bool "Log dumping support for TIMA"
    default n
    help
      TIMA Log dumping support
endif

endmenu

endif
```

## drivers/nfc/Kconfig
```kconfig
#
# Near Field Communication (NFC) devices
#

menuconfig NFC_DEVICES
	bool "Near Field Communication (NFC) devices"
	default n
	---help---
	  You'll have to say Y if your computer contains an NFC device that
	  you want to use under Linux.
	  You can say N here if you don't have any Near Field Communication devices connected to your computer.

if NFC_DEVICES

config PN544_NFC
	tristate "PN544 NFC driver"
	depends on I2C
	select CRC_CCITT
	default n
	---help---
	  Say yes if you want PN544 Near Field Communication driver.
	  This is for i2c connected version. If unsure, say N here.
	  To compile this driver as a module, choose m here. The module will be called pn544.

config BCM2079X_NFC_I2C
	tristate "BCM2079X NFC driver for I2C interface"
	depends on I2C
	default n
	---help---
	  Say yes if you want BCM2079X Near Field Communication driver.
	  This is for i2c connected version. If unsure, say N here.
	  To compile this driver as a module, choose m here. The module will be called bcm2079x-i2c.

config BCM2079X_NFC_SPI
	tristate "BCM2079X NFC driver for SPI interface"
	depends on SPI
	default n
	---help---
	  Say yes if you want BCM2079X Near Field Communication driver.
	  This is for spi connected version. If unsure, say N here.
	  To compile this driver as a module, choose m here. The module will be called bcm2079x-spi.

config SEC_NFC_I2C
    tristate "SEC NFC driver"
	depends on I2C
	default n
	---help---
	  Say yes if you want SEC Near Field Communication driver.
	  This is for i2c connected version. If unsure, say N here.
	  To compile this driver as a module, choose m here. The module will
	  be called sec-nfc.

config SEC_NFC_I2C_SB
    tristate "SEC SB NFC driver"
	depends on I2C
	default n
	---help---
	  Say yes if you want SEC Near Field Communication driver. (Secure F/W download version)
	  This is for i2c connected version. If unsure, say N here.
	  To compile this driver as a module, choose m here. The module will
	  be called sec-nfc.

config SEC_NFC_I2C_TYPE_SW
    tristate "SEC NFC I2C type (SW)"
	depends on SEC_NFC_I2C_SB
	default n
	---help---
	  Say yes if you want use S/W I2C for SEC Near Field Communication driver.
	  If unsure, say N here.
	  To compile this driver as a module, choose m here. The module will
	  be called sec-nfc.

config SEC_NFC
	bool "Samsung NFC driver"
	default n
	help
	  SAMSUNG NFC Driver.
	  This driver provides support for SAMSUNG NFC products.
	  You should select your NFC product and interface.
	  Say Y here to compile support for SAMSUNG NFC driver into the
	  kernel.

choice
	prompt "SEC NFC Products"
	depends on SEC_NFC
	default SEC_NFC_PRODUCT_N5
config SEC_NFC_PRODUCT_N3
	bool "N3"
config SEC_NFC_PRODUCT_N5
	bool "N5"
endchoice

choice
	prompt "SEC NFC Interface"
	depends on SEC_NFC
	default SEC_NFC_IF_I2C
config SEC_NFC_IF_UART
	bool "UART"
config SEC_NFC_IF_I2C
	depends on I2C
	bool "I2C"
config SEC_NFC_IF_I2C_GPIO
	bool "I2C-GPIO (S/W-I2C)"
	select I2C_ALGOBIT
endchoice

config SEC_NFC_CLK_REQ
	bool "External clock control (RF clock)"
	depends on SEC_NFC_PRODUCT_N5
	default n
	help
	  Driver controls NFC external clock.
	  This option should be enabled to control NFC external clock.
	  you should select if your NFC device requests exnternal clock.
	  Say Y here to compile support for exnternal clock control in the kernel.

config NFC_PN547
	tristate "NXP PN547 NFC Controller Driver"
	depends on I2C
	default n
	---help---
	  NXP PN547 Near Field Communication controller support.
	  This option enables device driver support for the NFC.
	  It is used by many services. NFC is fully controlled using I2C
          to communicate the AP chip.

endif # NFC_DEVICES
```
